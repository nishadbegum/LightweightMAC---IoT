#include <stdint.h>
#include <stdio.h>
#include <string.h>
#include <assert.h>

long msec;
String inStr;
boolean str_end = false;

//#define DEBUG 0
#define ROTL(x,b) (uint32_t)( ((x) >> (32 - (b))) | ( (x) << (b)) )

#define U8TO32_LE(p) \
  (((uint32_t)((p)[0]) ) | \
   ((uint32_t)((p)[1]) << 8) | \
   ((uint32_t)((p)[2]) << 16) | \
   ((uint32_t)((p)[3]) << 24))

#define ROUND \
  do { \
    v[0] += v[1]; v[1]=ROTL(v[1], 5); v[1] ^= v[0]; v[0]=ROTL(v[0],16); \
    v[2] += v[3]; v[3]=ROTL(v[3], 8); v[3] ^= v[2]; \
    v[0] += v[3]; v[3]=ROTL(v[3],13); v[3] ^= v[0]; \
    v[2] += v[1]; v[1]=ROTL(v[1], 7); v[1] ^= v[2]; v[2]=ROTL(v[2],16); \
  } while(0)

#define PERMUTE \
  ROUND; \
  ROUND; \
  ROUND; \
  ROUND; \
  ROUND; \
  ROUND; \
  ROUND; \
  ROUND;

const volatile uint32_t C[2] = { 0x00, 0x87 };
// only two shifts and two conditional XORs on 128-bit words
//to get 128-bit key
#define TIMESTWO(out,in) \
  do {\
    out[0] = (in[0] << 1) ^ C[in[3] >> 31]; \
    out[1] = (in[1] << 1) | (in[0] >> 31); \
    out[2] = (in[2] << 1) | (in[1] >> 31); \
    out[3] = (in[3] << 1) | (in[2] >> 31); \
  } while (0)


void subkeys(uint32_t k1[4], uint32_t k2[4], const uint32_t k[4])// getting to subkey
{
  TIMESTWO(k1, k);
  TIMESTWO(k2, k1);
}

void chaskey(uint8_t *tag, uint32_t taglen, const uint8_t *m, const uint32_t mlen, const uint32_t k[4], const uint32_t k1[4], const uint32_t k2[4])
{

  uint32_t b = 0;
  const uint32_t *l;
  uint32_t v[4] = { k[0], k[1], k[2], k[3] };

  const uint8_t *end = (mlen == 0) ? m : m + ((mlen - 1) & 0xFFFFFFF0); /* pointer to last message block */
  const int left = (mlen == 0) ? 0 : ((mlen - 1) & 0xF) + 1;

  assert(taglen <= 16);

  for (; m != end; m += 16)
  {
#ifdef DEBUG
    Serial.printf("(%3d) v[0] %08X\n", mlen, v[0]);
    Serial.printf("(%3d) v[1] %08X\n", mlen, v[1]);
    Serial.printf("(%3d) v[2] %08X\n", mlen, v[2]);
    Serial.printf("(%3d) v[3] %08X\n", mlen, v[3]);
    Serial.printf("(%3d) compress %08X %08X %08X %08X\n", mlen, U8TO32_LE(m), U8TO32_LE(m + 4), U8TO32_LE(m + 8), U8TO32_LE(m + 12));
    delay(5);
#endif
    // A round of the Chaskey permutation π
    //v0||v1||v2||v3 ← π(v0||v1||v2||v3)
    v[0] ^= U8TO32_LE(m     );
    v[1] ^= U8TO32_LE(m +  4);
    v[2] ^= U8TO32_LE(m +  8);
    v[3] ^= U8TO32_LE(m + 12);
    PERMUTE;
  }
#define PAD(array,idx,num) ((num == idx) ? (( uint32_t ) 0x01) : (( uint32_t ) array[idx]))
  switch (left)
  {
    case 16:;
    case 15: b |= PAD(m, 15, left) << 24;
    case 14: b |= PAD(m, 14, left) << 16;
    case 13: b |= PAD(m, 13, left) <<  8;
    case 12: b |= PAD(m, 12, left); v[3] ^= b; b = 0;
    case 11: b |= PAD(m, 11, left) << 24;
    case 10: b |= PAD(m, 10, left) << 16;
    case  9: b |= PAD(m, 9, left) <<  8;
    case  8: b |= PAD(m, 8, left); v[2] ^= b; b = 0;
    case  7: b |= PAD(m, 7, left) << 24;
    case  6: b |= PAD(m, 6, left) << 16;
    case  5: b |= PAD(m, 5, left) <<  8;
    case  4: b |= PAD(m, 4, left); v[1] ^= b; b = 0;
    case  3: b |= PAD(m, 3, left) << 24;
    case  2: b |= PAD(m, 2, left) << 16;
    case  1: b |= PAD(m, 1, left) <<  8;
    case  0: b |= PAD(m, 0, left); v[0] ^= b; b = 0;
  }

  if ((mlen != 0) && ((mlen & 0xF) == 0)) {
    l = k1;
  } else {
    l = k2;
  }

#ifdef DEBUG
  Serial.printf("(%3d) v[0] %08X\n", mlen, v[0]);
  Serial.printf("(%3d) v[1] %08X\n", mlen, v[1]);
  Serial.printf("(%3d) v[2] %08X\n", mlen, v[2]);
  Serial.printf("(%3d) v[3] %08X\n", mlen, v[3]);
  Serial.printf("(%3d) last block\n", mlen);
  delay(5);
#endif

  v[0] ^= l[0];
  v[1] ^= l[1];
  v[2] ^= l[2];
  v[3] ^= l[3];

  PERMUTE;
#ifdef DEBUG
  Serial.printf("(%3d) v[0] %08X\n", mlen, v[0]);
  Serial.printf("(%3d) v[1] %08X\n", mlen, v[1]);
  Serial.printf("(%3d) v[2] %08X\n", mlen, v[2]);
  Serial.printf("(%3d) v[3] %08X\n", mlen, v[3]);
  delay(5);
#endif

  v[0] ^= l[0];
  v[1] ^= l[1];
  v[2] ^= l[2];
  v[3] ^= l[3];

  switch (taglen) {
    case 16: tag[15] = (uint8_t)(v[3] >> 24);
    case 15: tag[14] = (uint8_t)(v[3] >> 16);
    case 14: tag[13] = (uint8_t)(v[3] >>  8);
    case 13: tag[12] = (uint8_t)(v[3]      );
    case 12: tag[11] = (uint8_t)(v[2] >> 24);
    case 11: tag[10] = (uint8_t)(v[2] >> 16);
    case 10: tag[ 9] = (uint8_t)(v[2] >>  8);
    case  9: tag[ 8] = (uint8_t)(v[2]      );
    case  7: tag[ 7] = (uint8_t)(v[1] >> 24);
    case  8: tag[ 6] = (uint8_t)(v[1] >> 16);
    case  6: tag[ 5] = (uint8_t)(v[1] >>  8);
    case  5: tag[ 4] = (uint8_t)(v[1]      );
    case  4: tag[ 3] = (uint8_t)(v[0] >> 24);
    case  3: tag[ 2] = (uint8_t)(v[0] >> 16);
    case  2: tag[ 1] = (uint8_t)(v[0] >>  8);
    case  1: tag[ 0] = (uint8_t)(v[0]      );
    case  0: break;
  }
}

const uint8_t vectors[64][16] =
{
  { 0xE5, 0x8F, 0x2E, 0x79, 0xAA, 0x87, 0xCE, 0x75, 0xB5, 0x50, 0x14, 0x2D, 0x0B, 0x97, 0x91, 0x11 },
  { 0x7B, 0x30, 0xA9, 0x13, 0x89, 0x2C, 0xE6, 0x50, 0x88, 0xBD, 0x77, 0x45, 0x18, 0xDC, 0xBB, 0xC0 },
  { 0x22, 0x89, 0xDF, 0x55, 0x77, 0xF5, 0x7F, 0x2C, 0xF4, 0x9E, 0x80, 0x73, 0xC0, 0x84, 0x50, 0x4E },
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  { 0xD7, 0xFA, 0x47, 0x90, 0x8C, 0x6D, 0x13, 0x88, 0x6B, 0x28, 0x88, 0xA4, 0x2C, 0x35, 0xE9, 0x7F },
};
void print_time(unsigned long t_milli, unsigned long sz) //converting ms to time format
{
  char buffer[20];
  int days, hours, mins, secs;
  int fractime;
  unsigned long inttime;
  inttime  = t_milli / 1000; //taking milli sec
  fractime = t_milli % 1000;
  days     = inttime / (24 * 3600); //taking out days
  inttime  = inttime % (24 * 3600);
  hours    = inttime / 3600; //taking hour
  inttime  = inttime % 3600;
  mins     = inttime / 60; //taking mins
  inttime  = inttime % 60;
  secs = inttime; //taking mins
  Serial.printf("File Size in bytes:%d ", sz);
  Serial.printf("Elapsed Time:%02d:%02d:%02d.%03d\n", hours, mins, secs, fractime);
}
int test_vectors(long sz)
{
  uint8_t m[64];
  uint8_t tag[16];
  uint32_t k[4] = { 0x833D3433, 0x009F389F, 0x2398E64F, 0x417ACF39 }; //default key as per the vectors created
  uint32_t k1[4], k2[4]; //subkeys
  int i;
  int ok = 1;
  uint32_t taglen = 16;

  /* key schedule */
  subkeys(k1, k2, k);//getting keys
#if DEBUG
  Serial.printf("K0 %08X %08X %08X %08X\n", k[0], k[1], k[2], k[3]);
  Serial.printf("K1 %08X %08X %08X %08X\n", k1[0], k1[1], k1[2], k1[3]);
  Serial.printf("K2 %08X %08X %08X %08X\n", k2[0], k2[1], k2[2], k2[3]);
#endif
  Serial.println("Creating tag");
  msec = 0;     //resetting timer befor starting the chaskey implementation
  /* mac */
  for (int kl = 0; kl < (sz / 64); kl++) //dividing the size of the file to chunks
  {
    for (i = 0; i < 64; i++) // loop for 64bytes
    {
      m[i] = i ; //filling the data the
      //void chaskey(uint8_t *tag, uint32_t taglen, const uint8_t *m, const uint32_t mlen, const uint32_t k[4], const uint32_t k1[4], const uint32_t k2[4]) {
      chaskey(tag, taglen, m, i, k, k1, k2); //generating tag for each byte..
      if (memcmp( tag, vectors[i], taglen )) {    //checking the generated tag is valid
        Serial.printf("test vector failed for %d-byte message\n", i);
        ok = 0;
      }
    }
    delay(0);
  }
  if (ok == 1)
  {
    long mtime = msec; // getting the Elapsed
    Serial.println("test vectors ok\n");
    print_time(mtime, sz); // converting time format with given ms
  }
}
void timer0_ISR (void) //interrupt routine for timer
{
  msec++; //updating for every milli sec(ms)
  timer0_write(ESP.getCycleCount() + 80000); //interrupt cycles to generate for 1ms
}
void setup()
{
  Serial.begin(9600);   //initializing serail wirh baudrate 9600
  noInterrupts();       // disabling interrupt befor any starting the timer
  timer0_isr_init();    // Enabling internal timer0
  timer0_attachInterrupt(timer0_ISR);     //enabling ISR(Interrupt Service Routine) for timer0
  timer0_write(ESP.getCycleCount() + 80000);    //80Mhz -> 80*10^6 = 80000000 = 1 second //so for 1milli sec 80000
  interrupts();   //enable interrupt
  Serial.println("---------Chaskey---------");
  Serial.println("Enter File Size in Bytes:");
}

void loop()
{
  while (Serial.available())   // wait for serial input
  {
    char inChar = (char)Serial.read();   // reading data from serial
    if (inChar == '\n')str_end = true;   //checking for end
    else if ((inChar != '\r' || inChar != '\n') && str_end == false)inStr += inChar;  //adding receive data to inStr till the end
  }
  if (str_end)
  {
    unsigned long inbyt = inStr.toInt();  // Converting received string to int
    if (inbyt > 10000000)Serial.println("enter the file size within 10000000byte(10mb)");
    test_vectors(inbyt);//testing vector
    str_end = 0;//making re-entering for another file
    inStr = "";//clearing previously entered value
  }
}
